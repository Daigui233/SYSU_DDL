/*********************************************************************************************************************
* 文件名称          Motor
* 车队名称          中山大学 DDL_大电流
* 开发平台          TC264D
*
* 修改记录
* 日期              作者                备注
* 2026-04-28       Daigui              初版
*********************************************************************************************************************/

#include "Motor.h"

motor_info_struct motor_info = {0, 0};

/*********************************************************************************************************************
* 函数名称          motor_duty_limit
* 功能说明          对电机占空比进行限幅
* 参数说明          duty            输入电机占空比
* 返回参数          int32           限幅后的电机占空比
* 使用示例          motor_duty_limit(12000);
* 备注信息          本函数为 Motor 模块内部静态函数
*                  逐飞库 PWM 底层最大占空比由 zf_driver_pwm.h 中的 PWM_DUTY_MAX 定义
*                  默认值为 10000 因此本函数将电机目标占空比限制在 [-10000, 10000] 范围内
*********************************************************************************************************************/
static int32 motor_duty_limit (int32 duty)
{
    if(MOTOR_PWM_DUTY_LIMIT < duty)
    {
        duty = MOTOR_PWM_DUTY_LIMIT;
    }
    else if(-MOTOR_PWM_DUTY_LIMIT > duty)
    {
        duty = -MOTOR_PWM_DUTY_LIMIT;
    }

    return duty;
}

/*********************************************************************************************************************
* 函数名称          motor_encoder_init
* 功能说明          初始化电机编码器
* 参数说明          无
* 返回参数          无
* 使用示例          motor_encoder_init();
* 备注信息          当前使用逐飞库方向计数方式初始化编码器
*********************************************************************************************************************/
void motor_encoder_init (void)
{
    encoder_dir_init(MOTOR_ENCODER, MOTOR_ENCODER_CH1, MOTOR_ENCODER_CH2);
    encoder_clear_count(MOTOR_ENCODER);
}

/*********************************************************************************************************************
* 函数名称          motor_init
* 功能说明          初始化电机 PWM 与编码器
* 参数说明          无
* 返回参数          无
* 使用示例          motor_init();
* 备注信息          初始化后默认电机停止输出
*********************************************************************************************************************/
void motor_init (void)
{
    pwm_init(MOTOR_FORWARD_PWM, MOTOR_PWM_FREQ, 0);
    pwm_init(MOTOR_REVERSE_PWM, MOTOR_PWM_FREQ, 0);

    motor_encoder_init();

    motor_info.speed = 0;
    motor_info.duty  = 0;
}

/*********************************************************************************************************************
* 函数名称          motor_get_count
* 功能说明          获取当前编码器计数值
* 参数说明          无
* 返回参数          int16           当前编码器计数值
* 使用示例          int16 count = motor_get_count();
* 备注信息          本函数不会清零编码器计数
*********************************************************************************************************************/
int16 motor_get_count (void)
{
    return encoder_get_count(MOTOR_ENCODER);
}

/*********************************************************************************************************************
* 函数名称          motor_get_speed
* 功能说明          获取当前周期速度并清零编码器计数
* 参数说明          无
* 返回参数          int16           当前周期速度值
* 使用示例          int16 speed = motor_get_speed();
* 备注信息          建议在固定周期控制中断中调用
*********************************************************************************************************************/
int16 motor_get_speed (void)
{
    motor_info.speed = encoder_get_count(MOTOR_ENCODER);
    encoder_clear_count(MOTOR_ENCODER);

    return motor_info.speed;
}

/*********************************************************************************************************************
* 函数名称          motor_set_duty
* 功能说明          设置电机 PWM 输出
* 参数说明          duty            电机目标占空比，正负决定转向
* 返回参数          无
* 使用示例          motor_set_duty(3000);
* 备注信息          占空比大于 0 时正转，小于 0 时反转，等于 0 时停车
*                  本函数内部会先完成占空比限幅，再将限幅后的结果分配到正反转 PWM 通道
*********************************************************************************************************************/
void motor_set_duty (int32 duty)
{
    duty = motor_duty_limit(duty);
    motor_info.duty = duty;

    if(0 < duty)
    {
        pwm_set_duty(MOTOR_REVERSE_PWM, 0);
        pwm_set_duty(MOTOR_FORWARD_PWM, duty);
    }
    else if(0 > duty)
    {
        pwm_set_duty(MOTOR_REVERSE_PWM, -duty);
        pwm_set_duty(MOTOR_FORWARD_PWM, 0);
    }
    else
    {
        pwm_set_duty(MOTOR_REVERSE_PWM, 0);
        pwm_set_duty(MOTOR_FORWARD_PWM, 0);
    }
}

/*********************************************************************************************************************
* 函数名称          motor_stop
* 功能说明          停止电机输出
* 参数说明          无
* 返回参数          无
* 使用示例          motor_stop();
* 备注信息          本函数等效于 motor_set_duty(0)
*********************************************************************************************************************/
void motor_stop (void)
{
    motor_set_duty(0);
}

